## CMakeLists.txt
```
# SPDX-License-Identifier: Apache-2.0

cmake_minimum_required(VERSION 3.20.0)

find_package(Zephyr REQUIRED HINTS $ENV{ZEPHYR_BASE})
project(cli)

target_include_directories(app PRIVATE include)

target_sources( app
    PRIVATE
        src/main.c
        src/b91_led.c
)

include(${ZEPHYR_BASE}/samples/net/common/common.cmake)

set(gen_dir ${ZEPHYR_BINARY_DIR}/include/generated/)
```

## Kconfig
```
# Config options for OpenThread sample app

# Copyright (c) 2020 Tridonic GmbH & Co KG
# SPDX-License-Identifier: Apache-2.0

mainmenu "OpenThread CLI"

menu "Application configuration"

config NET_SAMPLE_APPLICATION_VERSION
	string "Version number for the application"
	default "v0.0.0"

endmenu

source "Kconfig.zephyr"
```

## prj.conf
```kconfig
CONFIG_NETWORKING=y
CONFIG_NET_L2_OPENTHREAD=y

CONFIG_NET_PKT_RX_COUNT=8
CONFIG_NET_PKT_TX_COUNT=8

# Thread v1.3 features
CONFIG_OPENTHREAD_THREAD_VERSION_1_4=y
CONFIG_OPENTHREAD_SRP_CLIENT=y
CONFIG_OPENTHREAD_JOINER=y
CONFIG_OPENTHREAD_LINK_METRICS_SUBJECT=y
CONFIG_OPENTHREAD_BORDER_ROUTER=y
CONFIG_OPENTHREAD_COMMISSIONER=y
CONFIG_OPENTHREAD_PING_SENDER=y
CONFIG_OPENTHREAD_DHCP6_CLIENT=y
CONFIG_OPENTHREAD_DNS_CLIENT=y
CONFIG_OPENTHREAD_SLAAC=y
CONFIG_OPENTHREAD_REFERENCE_DEVICE=y
CONFIG_OPENTHREAD_MLR=y
CONFIG_OPENTHREAD_MAC_FILTER=y
CONFIG_OPENTHREAD_DUA=y
CONFIG_OPENTHREAD_COAP=y
CONFIG_OPENTHREAD_COAPS=y
CONFIG_OPENTHREAD_ENABLE_SERVICE=y
CONFIG_OPENTHREAD_NUM_MESSAGE_BUFFERS=350
CONFIG_OPENTHREAD_CSL_RECEIVE_TIME_AHEAD=480
CONFIG_OPENTHREAD_TCP_ENABLE=y
CONFIG_OPENTHREAD_NETDIAG_CLIENT=y
CONFIG_OPENTHREAD_LINK_METRICS_INITIATOR=y
CONFIG_OPENTHREAD_DNS_CLIENT_OVER_TCP=y

# Logging & shell
CONFIG_LOG=y
CONFIG_SHELL_VT100_COLORS=n
CONFIG_SHELL_PROMPT_UART=""
CONFIG_SHELL_BACKEND_SERIAL_TX_RING_BUFFER_SIZE=1024
CONFIG_SHELL_BACKEND_SERIAL_RX_RING_BUFFER_SIZE=1024
CONFIG_NET_SHELL=y
CONFIG_OPENTHREAD_SHELL=y
CONFIG_OPENTHREAD_MANUAL_START=y
CONFIG_SHELL_DEFAULT_TERMINAL_WIDTH=640
CONFIG_SHELL_CMD_BUFF_SIZE=640
CONFIG_OPENTHREAD_CLI_MAX_LINE_LENGTH=640

# thread network credentials
CONFIG_OPENTHREAD_CHANNEL=26
CONFIG_OPENTHREAD_PANID=1234
CONFIG_OPENTHREAD_XPANID="ff:0d:b8:ff:ff:ff:ff:01"
CONFIG_OPENTHREAD_NETWORKKEY="ff:ee:dd:cc:bb:aa:99:88:77:66:55:44:33:22:11:00"
```

## overlay-cli.conf
```kconfig
# This overlay switches from NCP to RCP, use in combination with prj.conf

CONFIG_OPENTHREAD_COPROCESSOR_NCP=n
CONFIG_OPENTHREAD_COPROCESSOR_RCP=n

CONFIG_NET_PKT_RX_COUNT=8
CONFIG_NET_PKT_TX_COUNT=8

CONFIG_IEEE802154_B91_RANDOM_MAC=n
CONFIG_IEEE802154_B91_MAC4=0x01
CONFIG_IEEE802154_B91_MAC5=0x02
CONFIG_IEEE802154_B91_MAC6=0x03
CONFIG_IEEE802154_B91_MAC7=0x04
```

## src/main.c
```c
/* main.c - OpenThread CLI */

/*
 * Copyright (c) 2020 Tridonic GmbH & Co KG
 *
 * SPDX-License-Identifier: Apache-2.0
 */


#include <zephyr/logging/log.h>
#include "b91_led.h"
LOG_MODULE_REGISTER(ot_cli, LOG_LEVEL_DBG);

#define APP_BANNER "***** OpenThread CLI on Zephyr %s *****"

void main(void)
{
	LED_Init();
	LOG_INF(APP_BANNER, CONFIG_NET_SAMPLE_APPLICATION_VERSION);
	LED_Toggle();
}
```

## include/b91_led.h
```c
#pragma once

#ifdef __cplusplus
extern "C" {
#endif

#define LED_PORT_B DEVICE_DT_GET(DT_NODELABEL(gpiob))
#define LED_PIN_6 6

int LED_Init();
void LED_Toggle();

#ifdef __cplusplus
}
#endif
```

## src/b91_led.c
```c
#include <zephyr/kernel.h>
#include <zephyr/device.h>
#include <zephyr/drivers/gpio.h>
#include <zephyr/sys/util.h>
#include <zephyr/sys/printk.h>
#include "b91_led.h"

#define REG_RW_BASE_ADDR  			0x80000000
#define REG_ADDR8(a)				(*(volatile unsigned char*)(REG_RW_BASE_ADDR | (a)))
#define reg_gpio_out(i)				REG_ADDR8(0x140303+((i>>8)<<3))

typedef enum{
		GPIO_GROUPA    = 0x000,
		GPIO_GROUPB    = 0x100,
		GPIO_GROUPC    = 0x200,
		GPIO_GROUPD    = 0x300,
		GPIO_GROUPE    = 0x400,
		GPIO_GROUPF    = 0x500,
		GPIO_ALL       = 0x600,
	    GPIO_PA0 = GPIO_GROUPA | BIT(0),
		GPIO_PA1 = GPIO_GROUPA | BIT(1),
		GPIO_PA2 = GPIO_GROUPA | BIT(2),
		GPIO_PA3 = GPIO_GROUPA | BIT(3),
		GPIO_PA4 = GPIO_GROUPA | BIT(4),
		GPIO_PA5 = GPIO_GROUPA | BIT(5),GPIO_DM=GPIO_PA5,
		GPIO_PA6 = GPIO_GROUPA | BIT(6),GPIO_DP=GPIO_PA6,
		GPIO_PA7 = GPIO_GROUPA | BIT(7),GPIO_SWS=GPIO_PA7,
		GPIOA_ALL = GPIO_GROUPA | 0x00ff,

		GPIO_PB0 = GPIO_GROUPB | BIT(0),
		GPIO_PB1 = GPIO_GROUPB | BIT(1),
		GPIO_PB2 = GPIO_GROUPB | BIT(2),
		GPIO_PB3 = GPIO_GROUPB | BIT(3),
		GPIO_PB4 = GPIO_GROUPB | BIT(4),
		GPIO_PB5 = GPIO_GROUPB | BIT(5),
		GPIO_PB6 = GPIO_GROUPB | BIT(6),
		GPIO_PB7 = GPIO_GROUPB | BIT(7),

		GPIO_PC0 = GPIO_GROUPC | BIT(0),GPIO_SWM=GPIO_PC0,
		GPIO_PC1 = GPIO_GROUPC | BIT(1),
		GPIO_PC2 = GPIO_GROUPC | BIT(2),
		GPIO_PC3 = GPIO_GROUPC | BIT(3),
		GPIO_PC4 = GPIO_GROUPC | BIT(4),
		GPIO_PC5 = GPIO_GROUPC | BIT(5),
		GPIO_PC6 = GPIO_GROUPC | BIT(6),
		GPIO_PC7 = GPIO_GROUPC | BIT(7),
		GPIOC_ALL = GPIO_GROUPC | 0x00ff,

		GPIO_PD0 = GPIO_GROUPD | BIT(0),
		GPIO_PD1 = GPIO_GROUPD | BIT(1),
		GPIO_PD2 = GPIO_GROUPD | BIT(2),
		GPIO_PD3 = GPIO_GROUPD | BIT(3),
		GPIO_PD4 = GPIO_GROUPD | BIT(4),
		GPIO_PD5 = GPIO_GROUPD | BIT(5),
		GPIO_PD6 = GPIO_GROUPD | BIT(6),
		GPIO_PD7 = GPIO_GROUPD | BIT(7),

		GPIO_PE0 = GPIO_GROUPE | BIT(0),
		GPIO_PE1 = GPIO_GROUPE | BIT(1),
		GPIO_PE2 = GPIO_GROUPE | BIT(2),
		GPIO_PE3 = GPIO_GROUPE | BIT(3),
		GPIO_PE4 = GPIO_GROUPE | BIT(4),
		GPIO_PE5 = GPIO_GROUPE | BIT(5),
		GPIO_PE6 = GPIO_GROUPE | BIT(6),
		GPIO_PE7 = GPIO_GROUPE | BIT(7),
		GPIOE_ALL = GPIO_GROUPE | 0x00ff,

		GPIO_PF0 = GPIO_GROUPF | BIT(0),
		GPIO_PF1 = GPIO_GROUPF | BIT(1),
		GPIO_PF2 = GPIO_GROUPF | BIT(2),
		GPIO_PF3 = GPIO_GROUPF | BIT(3),

}gpio_pin_e;

int LED_Init(void)
{
	int ret = 0;

	ret = gpio_pin_configure(LED_PORT_B, LED_PIN_6, GPIO_OUTPUT);
	if(ret < 0)
	{
		printk("Config in pin err: %d", ret);
		return ret;
	}

	ret = gpio_pin_set(LED_PORT_B, LED_PIN_6, 1);
	if(ret < 0)
	{
		printk("Set default value in pin err: %d", ret);
		return ret;
	}
	return ret;
}
/*
int LED_Toggle(void)
{
	int ret = 0;
	ret = gpio_pin_toggle(LED_PORT_B, LED_PIN_6);
	if(ret < 0)
	{
		printk("Toggle led fail!");
		return ret;
	}
	return ret;
}
*/

static inline void gpio_toggle(gpio_pin_e pin)
{
	reg_gpio_out(pin) ^= (pin & 0xFF);
}

void inline LED_Toggle(void)
{
	gpio_toggle(GPIO_PB6);
}
```
